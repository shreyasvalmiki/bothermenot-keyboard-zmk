## boards/shields/bother_me_not/Kconfig.defconfig
```kconfig
if SHIELD_BOTHER_ME_NOT_LEFT

config ZMK_KEYBOARD_NAME
    default "Bother Me Not"

config ZMK_SPLIT_ROLE_CENTRAL
    default y

config ZMK_SPLIT_BLE_CENTRAL_BATTERY_LEVEL_FETCHING
    default y

config ZMK_SPLIT_BLE_CENTRAL_BATTERY_LEVEL_PROXY
    default y

endif

if SHIELD_BOTHER_ME_NOT_LEFT || SHIELD_BOTHER_ME_NOT_RIGHT

config ZMK_SPLIT
    default y

endif
```

## boards/shields/bother_me_not/Kconfig.shield
```kconfig
config SHIELD_BOTHER_ME_NOT_LEFT
    def_bool $(shields_list_contains,bother_me_not_left)

config SHIELD_BOTHER_ME_NOT_RIGHT
    def_bool $(shields_list_contains,bother_me_not_right)
```
